## package/uboot-linino/Config.in
```kconfig
if PACKAGE_uboot-ar71xx-linino
	
config COMPRESSED_UBOOT
	bool
	prompt "Enable compressed uboot"
	depends on PACKAGE_uboot-ar71xx-linino
	default y	
config HORNET_1_1_WAR
	bool 
	prompt "Enable Hornet war"
	depends on PACKAGE_uboot-ar71xx-linino
	default y

config NEW_DDR_TAP_CAL
	bool 
	prompt "Enable new ddr tap"
	depends on PACKAGE_uboot-ar71xx-linino
	default y

config LININO_DDR2
	bool 
	prompt "Memory is DDR2"
	depends on PACKAGE_uboot-ar71xx-linino
	default y
endif
```

## toolchain/eglibc/Config.in
```kconfig
choice
	prompt "eglibc version"
	depends on TOOLCHAINOPTS && USE_EGLIBC
	default EGLIBC_USE_VERSION_2_15
	help
	  Select the version of eglibc you wish to use.

	config EGLIBC_USE_VERSION_2_15
		bool "eglibc 2.15"
		select EGLIBC_VERSION_2_15

endchoice

config EGLIBC_REVISION
	string
	depends on TOOLCHAINOPTS && USE_EGLIBC
	default "18909" if EGLIBC_VERSION_2_15
	default ""

menu "eglibc configuration"
	depends on TOOLCHAINOPTS && USE_EGLIBC
	source toolchain/eglibc/config/Config.in
endmenu
```
